## config/Kconfig
```kconfig
menu "TOTEM Customization"

config TOTEM_PROSPECTOR_BRIGHTNESS_DEFAULT
    int "Prospector default brightness"
    default 70
    range 0 100

config TOTEM_PROSPECTOR_BRIGHTNESS_STEP
    int "Prospector brightness step"
    default 10
    range 1 100

config TOTEM_PROSPECTOR_BRIGHTNESS_MIN
    int "Prospector minimum brightness"
    default 10
    range 0 100

config TOTEM_TELEMETRY
    bool "Enable Totem host telemetry"
    default n
    help
      Streams live layer and battery snapshots from the dongle to the host over
      a USB CDC ACM serial port.

config TOTEM_TELEMETRY_INTERVAL_MS
    int "Totem telemetry resend interval (ms)"
    default 5000
    range 250 60000
    depends on TOTEM_TELEMETRY

endmenu
```

## config/boards/shields/prospector_adapter_battery/Kconfig.shield
```kconfig
config SHIELD_PROSPECTOR_ADAPTER_BATTERY
    def_bool $(shields_list_contains,prospector_adapter_battery)
```

## config/dts/bindings/behaviors/zmk,behavior-prospector-brightness.yaml
```yaml
description: Prospector brightness behavior

compatible: "zmk,behavior-prospector-brightness"

include: zero_param.yaml

properties:
  direction:
    type: int
    required: true
```

## config/west.yml
```yaml
manifest:
  remotes:
    - name: zmkfirmware
      url-base: https://github.com/zmkfirmware
    - name: caksoylar
      url-base: https://github.com/caksoylar
    - name: carrefinho
      url-base: https://github.com/carrefinho
  projects:
    - name: zmk
      remote: zmkfirmware
      revision: main
      import: app/west.yml
    - name: zmk-smart-toggle
      remote: caksoylar
      revision: main
    - name: zmk-rgbled-widget
      remote: caksoylar
      revision: main
    - name: prospector-zmk-module
      remote: carrefinho
      revision: feat/new-status-screens
  self:
    path: config
```
