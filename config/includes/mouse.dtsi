#include <zephyr/dt-bindings/input/input-event-codes.h>

#define ZMK_POINTING_DEFAULT_MOVE_VAL 1250
#define ZMK_POINTING_DEFAULT_SCRL_VAL 30

#include <dt-bindings/zmk/pointing.h>
#include <input/processors.dtsi>

&mmv {
    acceleration-exponent = <1>;
    time-to-max-speed-ms = <500>;
    trigger-period-ms = <8>;
};

&msc {
    acceleration-exponent = <0>;
    time-to-max-speed-ms = <300>;
    trigger-period-ms = <8>;
};
